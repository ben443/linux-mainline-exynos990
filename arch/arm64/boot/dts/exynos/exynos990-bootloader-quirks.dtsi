/ {
	/* A dummy node for the bootloader. */
	dummy@0 {
		reg = <0 0x0 0 0x0>;
	};

	__symbols__ {
		pinctrl_0 = "/dummy@0";
		gpa0 = "/dummy@0";
		gpa1 = "/dummy@0";
		gpa2 = "/dummy@0";
		gpa3 = "/dummy@0";
		gpa4 = "/dummy@0";
		wlan_host_wake = "/dummy@0";
		gpq0 = "/dummy@0";
		speedy_bus = "/dummy@0";
		speedy1_bus = "/dummy@0";
		uart1_bus_single = "/dummy@0";
		uart1_rxd_pull = "/dummy@0";
		uart1_bus_rts = "/dummy@0";
		uart1_bus_tx_input = "/dummy@0";
		uart1_bus_tx_dat = "/dummy@0";
		uart1_bus_tx_con = "/dummy@0";
		pinctrl_1 = "/dummy@0";
		gpm0 = "/dummy@0";
		gpm1 = "/dummy@0";
		gpm2 = "/dummy@0";
		gpm3 = "/dummy@0";
		gpm4 = "/dummy@0";
		gpm5 = "/dummy@0";
		gpm6 = "/dummy@0";
		gpm7 = "/dummy@0";
		gpm8 = "/dummy@0";
		gpm9 = "/dummy@0";
		gpm10 = "/dummy@0";
		gpm11 = "/dummy@0";
		gpm12 = "/dummy@0";
		gpm13 = "/dummy@0";
		gpm14 = "/dummy@0";
		gpm15 = "/dummy@0";
		gpm16 = "/dummy@0";
		gpm17 = "/dummy@0";
		gpm18 = "/dummy@0";
		gpm19 = "/dummy@0";
		gpm20 = "/dummy@0";
		gpm21 = "/dummy@0";
		gpm22 = "/dummy@0";
		gpm23 = "/dummy@0";
		gpm24 = "/dummy@0";
		gpm25 = "/dummy@0";
		gpm26 = "/dummy@0";
		gpm27 = "/dummy@0";
		gpm28 = "/dummy@0";
		gpm29 = "/dummy@0";
		gpm30 = "/dummy@0";
		gpm31 = "/dummy@0";
		gpm32 = "/dummy@0";
		gpm33 = "/dummy@0";
		hsi2c38_bus = "/dummy@0";
		hsi2c39_bus = "/dummy@0";
		hsi2c40_bus = "/dummy@0";
		hsi2c41_bus = "/dummy@0";
		hsi2c42_bus = "/dummy@0";
		hsi2c43_bus = "/dummy@0";
		hsi2c44_bus = "/dummy@0";
		hsi2c45_bus = "/dummy@0";
		spi19_bus = "/dummy@0";
		spi19_cs = "/dummy@0";
		spi19_cs_func = "/dummy@0";
		spi20_bus = "/dummy@0";
		spi20_cs = "/dummy@0";
		spi20_cs_func = "/dummy@0";
		spi21_bus = "/dummy@0";
		spi21_cs = "/dummy@0";
		spi21_cs_func = "/dummy@0";
		spi22_bus = "/dummy@0";
		spi22_cs = "/dummy@0";
		spi22_cs_func = "/dummy@0";
		uart21_bus_single = "/dummy@0";
		uart21_bus_dual = "/dummy@0";
		uart22_bus_single = "/dummy@0";
		uart22_bus_dual = "/dummy@0";
		uart23_bus_single = "/dummy@0";
		uart23_bus_dual = "/dummy@0";
		uart24_bus_single = "/dummy@0";
		uart24_bus_dual = "/dummy@0";
		pinctrl_2 = "/dummy@0";
		gpf0 = "/dummy@0";
		gpf1 = "/dummy@0";
		gpf2 = "/dummy@0";
		ufs_rst_n = "/dummy@0";
		ufs_refclk_out = "/dummy@0";
		sd2_clk = "/dummy@0";
		sd2_cmd = "/dummy@0";
		sd2_bus1 = "/dummy@0";
		sd2_bus4 = "/dummy@0";
		sd2_clk_fast_slew_rate_1x = "/dummy@0";
		sd2_clk_fast_slew_rate_1_5x = "/dummy@0";
		sd2_clk_fast_slew_rate_2x = "/dummy@0";
		sd2_clk_fast_slew_rate_2_5x = "/dummy@0";
		sd2_clk_fast_slew_rate_3x = "/dummy@0";
		sd2_clk_fast_slew_rate_4x = "/dummy@0";
		sd2_pins_as_pdn = "/dummy@0";
		pcie0_clkreq = "/dummy@0";
		pcie0_perst = "/dummy@0";
		pcie1_clkreq = "/dummy@0";
		pcie1_perst = "/dummy@0";
		pinctrl_3 = "/dummy@0";
		gpf3 = "/dummy@0";
		pcie2_clkreq = "/dummy@0";
		pcie2_perst = "/dummy@0";
		pinctrl_4 = "/dummy@0";
		gpp0 = "/dummy@0";
		gpp1 = "/dummy@0";
		gpp2 = "/dummy@0";
		gpp3 = "/dummy@0";
		gpp4 = "/dummy@0";
		gpg0 = "/dummy@0";
		uart0_bus = "/dummy@0";
		hsi2c0_bus = "/dummy@0";
		hsi2c1_bus = "/dummy@0";
		hsi2c2_bus = "/dummy@0";
		hsi2c3_bus = "/dummy@0";
		hsi2c4_bus = "/dummy@0";
		hsi2c5_bus = "/dummy@0";
		hsi2c6_bus = "/dummy@0";
		hsi2c7_bus = "/dummy@0";
		hsi2c8_bus = "/dummy@0";
		hsi2c9_bus = "/dummy@0";
		hsi2c10_bus = "/dummy@0";
		hsi2c11_bus = "/dummy@0";
		hsi2c26_bus = "/dummy@0";
		hsi2c27_bus = "/dummy@0";
		hsi2c28_bus = "/dummy@0";
		hsi2c29_bus = "/dummy@0";
		hsi2c30_bus = "/dummy@0";
		hsi2c31_bus = "/dummy@0";
		spi0_bus = "/dummy@0";
		spi0_cs = "/dummy@0";
		spi0_cs_func = "/dummy@0";
		spi1_bus = "/dummy@0";
		spi1_cs = "/dummy@0";
		spi1_cs_func = "/dummy@0";
		spi2_bus = "/dummy@0";
		spi2_cs = "/dummy@0";
		spi2_cs_func = "/dummy@0";
		spi3_bus = "/dummy@0";
		spi3_cs = "/dummy@0";
		spi3_cs_func = "/dummy@0";
		spi4_bus = "/dummy@0";
		spi4_cs = "/dummy@0";
		spi4_cs_func = "/dummy@0";
		spi4_fp_inactive = "/dummy@0";
		spi4_fp_cs_func_high = "/dummy@0";
		spi5_bus = "/dummy@0";
		spi5_cs = "/dummy@0";
		spi5_cs_func = "/dummy@0";
		spi13_bus = "/dummy@0";
		spi13_cs = "/dummy@0";
		spi13_cs_func = "/dummy@0";
		spi14_bus = "/dummy@0";
		spi14_cs = "/dummy@0";
		spi14_cs_func = "/dummy@0";
		spi15_bus = "/dummy@0";
		spi15_cs = "/dummy@0";
		spi15_cs_func = "/dummy@0";
		uart2_bus_single = "/dummy@0";
		uart2_bus_dual = "/dummy@0";
		uart3_bus_single = "/dummy@0";
		uart3_bus_dual = "/dummy@0";
		uart4_bus_single = "/dummy@0";
		uart4_bus_dual = "/dummy@0";
		uart5_bus_single = "/dummy@0";
		uart5_bus_dual = "/dummy@0";
		uart6_bus_single = "/dummy@0";
		uart6_bus_dual = "/dummy@0";
		uart7_bus_single = "/dummy@0";
		uart7_bus_dual = "/dummy@0";
		uart15_bus_single = "/dummy@0";
		uart15_bus_dual = "/dummy@0";
		uart16_bus_single = "/dummy@0";
		uart16_bus_dual = "/dummy@0";
		uart17_bus_single = "/dummy@0";
		uart17_bus_dual = "/dummy@0";
		pinctrl_5 = "/dummy@0";
		gpp5 = "/dummy@0";
		gpp6 = "/dummy@0";
		gpp7 = "/dummy@0";
		gpp8 = "/dummy@0";
		gpp9 = "/dummy@0";
		gpc0 = "/dummy@0";
		gpg1 = "/dummy@0";
		gpb0 = "/dummy@0";
		cfg_wlanen = "/dummy@0";
		cnss_wlan_en_active = "/dummy@0";
		cnss_wlan_en_sleep = "/dummy@0";
		gpb1 = "/dummy@0";
		gpb2 = "/dummy@0";
		hsi2c12_bus = "/dummy@0";
		hsi2c13_bus = "/dummy@0";
		hsi2c14_bus = "/dummy@0";
		hsi2c15_bus = "/dummy@0";
		hsi2c16_bus = "/dummy@0";
		hsi2c17_bus = "/dummy@0";
		hsi2c18_bus = "/dummy@0";
		hsi2c19_bus = "/dummy@0";
		hsi2c20_bus = "/dummy@0";
		hsi2c21_bus = "/dummy@0";
		hsi2c22_bus = "/dummy@0";
		hsi2c23_bus = "/dummy@0";
		hsi2c24_bus = "/dummy@0";
		hsi2c25_bus = "/dummy@0";
		hsi2c32_bus = "/dummy@0";
		hsi2c33_bus = "/dummy@0";
		hsi2c34_bus = "/dummy@0";
		hsi2c35_bus = "/dummy@0";
		hsi2c36_bus = "/dummy@0";
		hsi2c37_bus = "/dummy@0";
		spi6_bus = "/dummy@0";
		spi6_cs = "/dummy@0";
		spi6_cs_func = "/dummy@0";
		spi7_bus = "/dummy@0";
		spi7_cs = "/dummy@0";
		spi7_cs_func = "/dummy@0";
		spi8_bus = "/dummy@0";
		spi8_cs = "/dummy@0";
		spi8_cs_func = "/dummy@0";
		spi9_bus = "/dummy@0";
		spi9_cs = "/dummy@0";
		spi9_cs_func = "/dummy@0";
		spi10_bus = "/dummy@0";
		spi10_cs = "/dummy@0";
		spi10_cs_func = "/dummy@0";
		spi11_bus = "/dummy@0";
		spi11_cs = "/dummy@0";
		spi11_cs_func = "/dummy@0";
		spi12_bus = "/dummy@0";
		spi12_cs = "/dummy@0";
		spi12_cs_func = "/dummy@0";
		spi16_bus = "/dummy@0";
		spi16_cs = "/dummy@0";
		spi16_cs_func = "/dummy@0";
		spi17_bus = "/dummy@0";
		spi17_cs = "/dummy@0";
		spi17_cs_func = "/dummy@0";
		spi18_bus = "/dummy@0";
		spi18_cs = "/dummy@0";
		spi18_cs_func = "/dummy@0";
		uart8_bus_single = "/dummy@0";
		uart8_bus_dual = "/dummy@0";
		uart9_bus_single = "/dummy@0";
		uart9_bus_dual = "/dummy@0";
		uart10_bus_single = "/dummy@0";
		uart10_bus_dual = "/dummy@0";
		uart11_bus_single = "/dummy@0";
		uart11_bus_dual = "/dummy@0";
		uart12_bus_single = "/dummy@0";
		uart12_bus_dual = "/dummy@0";
		uart13_bus_single = "/dummy@0";
		uart13_bus_dual = "/dummy@0";
		uart14_bus_single = "/dummy@0";
		uart14_bus_dual = "/dummy@0";
		uart18_bus_single = "/dummy@0";
		uart18_bus_dual = "/dummy@0";
		uart19_bus_single = "/dummy@0";
		uart19_bus_dual = "/dummy@0";
		uart20_bus_single = "/dummy@0";
		uart20_bus_dual = "/dummy@0";
		decon_f_te_on = "/dummy@0";
		decon_f_te_off = "/dummy@0";
		decon_s_te_on = "/dummy@0";
		decon_s_te_off = "/dummy@0";
		aud_i2s0_bus = "/dummy@0";
		aud_i2s0_idle = "/dummy@0";
		aud_i2s1_bus = "/dummy@0";
		aud_i2s1_idle = "/dummy@0";
		aud_i2s2_bus = "/dummy@0";
		aud_i2s2_idle = "/dummy@0";
		aud_i2s3_bus = "/dummy@0";
		aud_i2s3_idle = "/dummy@0";
		aud_i2s4_bus = "/dummy@0";
		aud_i2s4_pci = "/dummy@0";
		aud_i2s4_idle = "/dummy@0";
		aud_i2s5_bus = "/dummy@0";
		aud_i2s5_idle = "/dummy@0";
		aud_dsd_bus = "/dummy@0";
		aud_dsd_idle = "/dummy@0";
		sensor_mclk0_out = "/dummy@0";
		sensor_mclk1_out = "/dummy@0";
		sensor_mclk2_out = "/dummy@0";
		sensor_mclk3_out = "/dummy@0";
		sensor_mclk4_out = "/dummy@0";
		sensor_mclk5_out = "/dummy@0";
		sensor_mclk0_fn = "/dummy@0";
		sensor_mclk1_fn = "/dummy@0";
		sensor_mclk2_fn = "/dummy@0";
		sensor_mclk3_fn = "/dummy@0";
		sensor_mclk4_fn = "/dummy@0";
		sensor_mclk5_fn = "/dummy@0";
		xboot_ldo = "/dummy@0";
		pinctrl_6 = "/dummy@0";
		gpv0 = "/dummy@0";
		dmic_bus_clk = "/dummy@0";
		dmic_bus_clk_idle = "/dummy@0";
		dmic_bus_clk1 = "/dummy@0";
		dmic_bus_clk1_idle = "/dummy@0";
		dmic_bus_clk2 = "/dummy@0";
		dmic_bus_clk2_idle = "/dummy@0";
		dmic_pdm = "/dummy@0";
		amic_pdm = "/dummy@0";
		dmic_pdm_idle = "/dummy@0";
		dmic_pdm1_bus = "/dummy@0";
		dmic_pdm1_idle = "/dummy@0";
		dmic_pdm2_bus = "/dummy@0";
		dmic_pdm2_idle = "/dummy@0";
		reserved_memory = "/dummy@0";
		abox_dbg = "/dummy@0";
		abox_slog = "/dummy@0";
		abox_rmem = "/dummy@0";
		abox_rdma_compr = "/dummy@0";
		vts_rmem = "/dummy@0";
		abox_pci_rmem = "/dummy@0";
		dp_ado_rmem = "/dummy@0";
		camera_rmem = "/dummy@0";
		camera_heap = "/dummy@0";
		teegris_rmem = "/dummy@0";
		sysmmu_dpu0 = "/dummy@0";
		sysmmu_dpu1 = "/dummy@0";
		sysmmu_dpu2 = "/dummy@0";
		sysmmu_csis0 = "/dummy@0";
		sysmmu_csis1 = "/dummy@0";
		sysmmu_ipp = "/dummy@0";
		sysmmu_tnr0 = "/dummy@0";
		sysmmu_tnr1 = "/dummy@0";
		sysmmu_dns = "/dummy@0";
		sysmmu_mcsc0 = "/dummy@0";
		sysmmu_mcsc1 = "/dummy@0";
		sysmmu_g2d0 = "/dummy@0";
		sysmmu_g2d1 = "/dummy@0";
		sysmmu_g2d2 = "/dummy@0";
		sysmmu_aud = "/dummy@0";
		sysmmu_dnc0 = "/dummy@0";
		sysmmu_dnc1 = "/dummy@0";
		sysmmu_dnc2 = "/dummy@0";
		sysmmu_dnc3 = "/dummy@0";
		sysmmu_dnc4 = "/dummy@0";
		sysmmu_vra = "/dummy@0";
		sysmmu_mfc0 = "/dummy@0";
		sysmmu_mfc1 = "/dummy@0";
		usi_0 = "/dummy@0";
		usi_0_i2c = "/dummy@0";
		usi_1 = "/dummy@0";
		usi_1_i2c = "/dummy@0";
		usi_2 = "/dummy@0";
		usi_2_i2c = "/dummy@0";
		usi_3 = "/dummy@0";
		usi_3_i2c = "/dummy@0";
		usi_4 = "/dummy@0";
		usi_4_i2c = "/dummy@0";
		usi_5 = "/dummy@0";
		usi_5_i2c = "/dummy@0";
		usi_6 = "/dummy@0";
		usi_6_i2c = "/dummy@0";
		usi_7 = "/dummy@0";
		usi_7_i2c = "/dummy@0";
		usi_8 = "/dummy@0";
		usi_8_i2c = "/dummy@0";
		usi_9 = "/dummy@0";
		usi_9_i2c = "/dummy@0";
		usi_10 = "/dummy@0";
		usi_10_i2c = "/dummy@0";
		usi_11 = "/dummy@0";
		usi_11_i2c = "/dummy@0";
		usi_12 = "/dummy@0";
		usi_12_i2c = "/dummy@0";
		usi_13 = "/dummy@0";
		usi_13_i2c = "/dummy@0";
		usi_14 = "/dummy@0";
		usi_14_i2c = "/dummy@0";
		usi_15 = "/dummy@0";
		usi_15_i2c = "/dummy@0";
		usi_16 = "/dummy@0";
		usi_16_i2c = "/dummy@0";
		usi_17 = "/dummy@0";
		usi_17_i2c = "/dummy@0";
		usi_18 = "/dummy@0";
		usi_18_i2c = "/dummy@0";
		usi_00_cmgp = "/dummy@0";
		usi_00_cmgp_i2c = "/dummy@0";
		usi_01_cmgp = "/dummy@0";
		usi_01_cmgp_i2c = "/dummy@0";
		usi_02_cmgp = "/dummy@0";
		usi_02_cmgp_i2c = "/dummy@0";
		usi_03_cmgp = "/dummy@0";
		usi_03_cmgp_i2c = "/dummy@0";
		usi_uart_dbg = "/dummy@0";
		usi_uart_bt = "/dummy@0";
		hsi2c_0 = "/dummy@0";
		hsi2c_1 = "/dummy@0";
		hsi2c_2 = "/dummy@0";
		hsi2c_3 = "/dummy@0";
		hsi2c_4 = "/dummy@0";
		hsi2c_5 = "/dummy@0";
		hsi2c_6 = "/dummy@0";
		hsi2c_7 = "/dummy@0";
		hsi2c_8 = "/dummy@0";
		hsi2c_9 = "/dummy@0";
		hsi2c_10 = "/dummy@0";
		hsi2c_11 = "/dummy@0";
		hsi2c_12 = "/dummy@0";
		hsi2c_13 = "/dummy@0";
		hsi2c_14 = "/dummy@0";
		hsi2c_15 = "/dummy@0";
		hsi2c_16 = "/dummy@0";
		hsi2c_17 = "/dummy@0";
		hsi2c_18 = "/dummy@0";
		hsi2c_19 = "/dummy@0";
		hsi2c_20 = "/dummy@0";
		hsi2c_21 = "/dummy@0";
		hsi2c_22 = "/dummy@0";
		hsi2c_23 = "/dummy@0";
		hsi2c_24 = "/dummy@0";
		hsi2c_25 = "/dummy@0";
		hsi2c_26 = "/dummy@0";
		hsi2c_27 = "/dummy@0";
		hsi2c_28 = "/dummy@0";
		hsi2c_29 = "/dummy@0";
		hsi2c_30 = "/dummy@0";
		hsi2c_31 = "/dummy@0";
		hsi2c_32 = "/dummy@0";
		hsi2c_33 = "/dummy@0";
		hsi2c_34 = "/dummy@0";
		hsi2c_35 = "/dummy@0";
		hsi2c_36 = "/dummy@0";
		hsi2c_37 = "/dummy@0";
		hsi2c_38 = "/dummy@0";
		hsi2c_39 = "/dummy@0";
		hsi2c_40 = "/dummy@0";
		hsi2c_41 = "/dummy@0";
		hsi2c_42 = "/dummy@0";
		hsi2c_43 = "/dummy@0";
		hsi2c_44 = "/dummy@0";
		hsi2c_45 = "/dummy@0";
		spi_0 = "/dummy@0";
		spi_1 = "/dummy@0";
		spi_2 = "/dummy@0";
		spi_3 = "/dummy@0";
		spi_4 = "/dummy@0";
		spi_5 = "/dummy@0";
		spi_6 = "/dummy@0";
		spi_7 = "/dummy@0";
		spi_8 = "/dummy@0";
		spi_9 = "/dummy@0";
		spi_10 = "/dummy@0";
		spi_11 = "/dummy@0";
		spi_12 = "/dummy@0";
		spi_13 = "/dummy@0";
		spi_14 = "/dummy@0";
		spi_15 = "/dummy@0";
		spi_16 = "/dummy@0";
		spi_17 = "/dummy@0";
		spi_18 = "/dummy@0";
		spi_19 = "/dummy@0";
		spi_20 = "/dummy@0";
		spi_21 = "/dummy@0";
		spi_22 = "/dummy@0";
		serial_0 = "/dummy@0";
		serial_1 = "/dummy@0";
		serial_2 = "/dummy@0";
		serial_3 = "/dummy@0";
		serial_4 = "/dummy@0";
		serial_5 = "/dummy@0";
		serial_6 = "/dummy@0";
		serial_7 = "/dummy@0";
		serial_8 = "/dummy@0";
		serial_9 = "/dummy@0";
		serial_10 = "/dummy@0";
		serial_11 = "/dummy@0";
		serial_12 = "/dummy@0";
		serial_13 = "/dummy@0";
		serial_14 = "/dummy@0";
		serial_15 = "/dummy@0";
		serial_16 = "/dummy@0";
		serial_17 = "/dummy@0";
		serial_18 = "/dummy@0";
		serial_19 = "/dummy@0";
		serial_20 = "/dummy@0";
		serial_21 = "/dummy@0";
		serial_22 = "/dummy@0";
		serial_23 = "/dummy@0";
		serial_24 = "/dummy@0";
		pd_aud = "/dummy@0";
		pd_csis = "/dummy@0";
		pd_dns = "/dummy@0";
		pd_dpu = "/dummy@0";
		pd_dsp0 = "/dummy@0";
		pd_dsp1 = "/dummy@0";
		pd_dsp2 = "/dummy@0";
		pd_dnc = "/dummy@0";
		pd_embedded_g3d = "/dummy@0";
		pd_g2d = "/dummy@0";
		pd_hsi0 = "/dummy@0";
		pd_ipp = "/dummy@0";
		pd_itp = "/dummy@0";
		pd_mfc0 = "/dummy@0";
		pd_mcsc = "/dummy@0";
		pd_npu00 = "/dummy@0";
		pd_npu01 = "/dummy@0";
		pd_npu10 = "/dummy@0";
		pd_npu11 = "/dummy@0";
		pd_tnr = "/dummy@0";
		pd_vra = "/dummy@0";
		pd_vts = "/dummy@0";
		pd_ssp = "/dummy@0";
		abox_gic = "/dummy@0";
		abox = "/dummy@0";
		abox_core0 = "/dummy@0";
		abox_firmware_sram0 = "/dummy@0";
		abox_firmware_dram0 = "/dummy@0";
		abox_core1 = "/dummy@0";
		abox_firmware_sram1 = "/dummy@0";
		abox_firmware_dram1 = "/dummy@0";
		abox_rdma_0 = "/dummy@0";
		abox_rdma_1 = "/dummy@0";
		abox_rdma_2 = "/dummy@0";
		abox_rdma_3 = "/dummy@0";
		abox_rdma_4 = "/dummy@0";
		abox_rdma_5 = "/dummy@0";
		abox_rdma_6 = "/dummy@0";
		abox_rdma_7 = "/dummy@0";
		abox_rdma_8 = "/dummy@0";
		abox_rdma_9 = "/dummy@0";
		abox_rdma_10 = "/dummy@0";
		abox_rdma_11 = "/dummy@0";
		abox_wdma_0 = "/dummy@0";
		abox_wdma_1 = "/dummy@0";
		abox_wdma_2 = "/dummy@0";
		abox_wdma_3 = "/dummy@0";
		abox_wdma_4 = "/dummy@0";
		abox_dual_0 = "/dummy@0";
		abox_dual_1 = "/dummy@0";
		abox_dual_2 = "/dummy@0";
		abox_dual_3 = "/dummy@0";
		abox_dual_4 = "/dummy@0";
		abox_ddma_0 = "/dummy@0";
		abox_ddma_1 = "/dummy@0";
		abox_ddma_2 = "/dummy@0";
		abox_ddma_3 = "/dummy@0";
		abox_ddma_4 = "/dummy@0";
		abox_ddma_5 = "/dummy@0";
		abox_uaif_0 = "/dummy@0";
		abox_uaif_1 = "/dummy@0";
		abox_uaif_2 = "/dummy@0";
		abox_uaif_3 = "/dummy@0";
		abox_uaif_4 = "/dummy@0";
		abox_uaif_5 = "/dummy@0";
		abox_uaif_6 = "/dummy@0";
		abox_dsif = "/dummy@0";
		abox_effect = "/dummy@0";
		abox_debug = "/dummy@0";
		abox_vss = "/dummy@0";
		abox_tplg = "/dummy@0";
		abox_pci = "/dummy@0";
		ext_bin_0 = "/dummy@0";
		ext_bin_1 = "/dummy@0";
		ext_bin_2 = "/dummy@0";
		ext_bin_3 = "/dummy@0";
		ext_bin_4 = "/dummy@0";
		ext_bin_5 = "/dummy@0";
		mailbox_vts = "/dummy@0";
		vts = "/dummy@0";
		vts_dma0 = "/dummy@0";
		vts_dma1 = "/dummy@0";
		vts_s_lif = "/dummy@0";
		displayport_adma = "/dummy@0";
		dp_dma0 = "/dummy@0";
		dp_dma1 = "/dummy@0";
		s2d = "/dummy@0";
		ehld = "/dummy@0";
		cs_etf0 = "/dummy@0";
		cs_etf1 = "/dummy@0";
		etm0_out_port = "/dummy@0";
		etm1_out_port = "/dummy@0";
		etm2_out_port = "/dummy@0";
		etm3_out_port = "/dummy@0";
		etm4_out_port = "/dummy@0";
		etm5_out_port = "/dummy@0";
		etm6_out_port = "/dummy@0";
		etm7_out_port = "/dummy@0";
		etf0_in_port = "/dummy@0";
		etf0_out_port = "/dummy@0";
		etf1_in_port = "/dummy@0";
		etf1_out_port = "/dummy@0";
		etr_in_port = "/dummy@0";
		stm_out_port = "/dummy@0";
		funnel0_out_port0 = "/dummy@0";
		funnel0_in_port0 = "/dummy@0";
		funnel0_in_port1 = "/dummy@0";
		funnel0_in_port2 = "/dummy@0";
		funnel0_in_port3 = "/dummy@0";
		funnel0_in_port4 = "/dummy@0";
		funnel0_in_port5 = "/dummy@0";
		funnel1_out_port0 = "/dummy@0";
		funnel1_in_port0 = "/dummy@0";
		funnel1_in_port1 = "/dummy@0";
		funnel1_in_port7 = "/dummy@0";
		funnelm_out_port0 = "/dummy@0";
		funnelm_in_port0 = "/dummy@0";
		funnelm_in_port1 = "/dummy@0";
		mali = "/dummy@0";
		freq_898 = "/dummy@0";
		freq_903_5 = "/dummy@0";
		freq_910 = "/dummy@0";
		freq_929_5 = "/dummy@0";
		freq_1110 = "/dummy@0";
		freq_1114 = "/dummy@0";
		freq_1124 = "/dummy@0";
		freq_1143 = "/dummy@0";
		freq_1150 = "/dummy@0";
		freq_1157 = "/dummy@0";
		freq_1176 = "/dummy@0";
		freq_1194 = "/dummy@0";
		freq_1160 = "/dummy@0";
		freq_1170 = "/dummy@0";
		emul_display = "/dummy@0";
		s6e3hf4 = "/dummy@0";
		s6e3ha2k = "/dummy@0";
		s6e3ha3 = "/dummy@0";
		s6e3ha6 = "/dummy@0";
		s6e3ha8 = "/dummy@0";
		s6e3ha9 = "/dummy@0";
		s6e3hab = "/dummy@0";
		s6e3hac = "/dummy@0";
		s6e3hab_fhd = "/dummy@0";
		s6e3fa9 = "/dummy@0";
		s6e3fab = "/dummy@0";
		s6e3xa0 = "/dummy@0";
		s6e3fa7 = "/dummy@0";
		s6e3fa0 = "/dummy@0";
		s6e3fa0_vid = "/dummy@0";
		ea8076 = "/dummy@0";
		ea8079 = "/dummy@0";
		s6e3fc3 = "/dummy@0";
		mcdhdr_0 = "/dummy@0";
		mcdhdr_1 = "/dummy@0";
		mcdhdr_2 = "/dummy@0";
		mcdhdr_3 = "/dummy@0";
		mcdhdr_4 = "/dummy@0";
		mcdhdr_5 = "/dummy@0";
		dpp_0 = "/dummy@0";
		dpp_1 = "/dummy@0";
		dpp_2 = "/dummy@0";
		dpp_3 = "/dummy@0";
		dpp_4 = "/dummy@0";
		dpp_5 = "/dummy@0";
		dpp_6 = "/dummy@0";
		disp_ss = "/dummy@0";
		mipi_phy_dsim0_m4m4 = "/dummy@0";
		dsim_0 = "/dummy@0";
		panel_0 = "/dummy@0";
		panel_drv_0 = "/dummy@0";
		displayport = "/dummy@0";
		decon_f = "/dummy@0";
		decon_s = "/dummy@0";
		decon_t = "/dummy@0";
		mafpc_0 = "/dummy@0";
		mfc_0 = "/dummy@0";
		pcie_0 = "/dummy@0";
		pcie_1 = "/dummy@0";
		pcie_2 = "/dummy@0";
		exynos_is = "/dummy@0";
		camerapp_gdc = "/dummy@0";
		camerapp_votf = "/dummy@0";
		camif_wdma0_0 = "/dummy@0";
		camif_wdma0_1 = "/dummy@0";
		camif_wdma0_2 = "/dummy@0";
		camif_wdma0_3 = "/dummy@0";
		camif_wdma0 = "/dummy@0";
		sysreg_isppre_reset = "/dummy@0";
		mipi_phy_csis0_m0s4s4s4s4s4s2 = "/dummy@0";
		mipi_phy_csis1_m0s4s4s4s4s4s2 = "/dummy@0";
		mipi_phy_csis2_m0s4s4s4s4s4s2 = "/dummy@0";
		mipi_phy_csis3_m0s4s4s4s4s4s2 = "/dummy@0";
		mipi_phy_csis4_m0s4s4s4s4s4s2 = "/dummy@0";
		mipi_phy_csis5_m0s4s4s4s4s4s2 = "/dummy@0";
		is_sensor0 = "/dummy@0";
		sensor0_ch_mode0 = "/dummy@0";
		is_sensor1 = "/dummy@0";
		sensor1_ch_mode0 = "/dummy@0";
		is_sensor2 = "/dummy@0";
		sensor2_ch_mode0 = "/dummy@0";
		is_sensor3 = "/dummy@0";
		sensor3_ch_mode0 = "/dummy@0";
		is_sensor4 = "/dummy@0";
		sensor4_ch_mode0 = "/dummy@0";
		is_sensor5 = "/dummy@0";
		sensor5_ch_mode0 = "/dummy@0";
		lic_lut_origin = "/dummy@0";
		sensor_paf_pdp_0 = "/dummy@0";
		sensor_paf_pdp_1 = "/dummy@0";
		sensor_paf_pdp_2 = "/dummy@0";
		ois_mcu = "/dummy@0";
		set0 = "/dummy@0";
		set1 = "/dummy@0";
		set2 = "/dummy@0";
		set3 = "/dummy@0";
		set4 = "/dummy@0";
		set5 = "/dummy@0";
		set6 = "/dummy@0";
		set7 = "/dummy@0";
		set8 = "/dummy@0";
		set9 = "/dummy@0";
		set10 = "/dummy@0";
		set11 = "/dummy@0";
		set12 = "/dummy@0";
		set13 = "/dummy@0";
		set14 = "/dummy@0";
		set15 = "/dummy@0";
		set16 = "/dummy@0";
		set17 = "/dummy@0";
		set18 = "/dummy@0";
		set19 = "/dummy@0";
		set20 = "/dummy@0";
		set21 = "/dummy@0";
		set22 = "/dummy@0";
		set23 = "/dummy@0";
		set24 = "/dummy@0";
		set25 = "/dummy@0";
		set26 = "/dummy@0";
		set27 = "/dummy@0";
		set28 = "/dummy@0";
		set29 = "/dummy@0";
		set30 = "/dummy@0";
		set31 = "/dummy@0";
		chosen = "/dummy@0";
		fmp_0 = "/dummy@0";
		cpu0 = "/dummy@0";
		cpu1 = "/dummy@0";
		cpu2 = "/dummy@0";
		cpu3 = "/dummy@0";
		cpu4 = "/dummy@0";
		cpu5 = "/dummy@0";
		cpu6 = "/dummy@0";
		cpu7 = "/dummy@0";
		L2_ANANKE_0 = "/dummy@0";
		L2_ANANKE_1 = "/dummy@0";
		L2_ANANKE_2 = "/dummy@0";
		L2_ANANKE_3 = "/dummy@0";
		L2_ENYO_0 = "/dummy@0";
		L2_ENYO_1 = "/dummy@0";
		L2_LION = "/dummy@0";
		L3_DSU = "/dummy@0";
		L3_LION = "/dummy@0";
		ANANKE_CPU_SLEEP = "/dummy@0";
		ENYO_CPU_SLEEP = "/dummy@0";
		LION_CPU_SLEEP = "/dummy@0";
		ANANKE_FREQ_FACTOR = "/dummy@0";
		ENYO_FREQ_FACTOR = "/dummy@0";
		LION_FREQ_FACTOR = "/dummy@0";
		ANANKE_ENERGY = "/dummy@0";
		ENYO_ENERGY = "/dummy@0";
		LION_ENERGY = "/dummy@0";
		schedutil_domain0 = "/dummy@0";
		schedutil_domain1 = "/dummy@0";
		cpufreq_domain0 = "/dummy@0";
		cpufreq_domain1 = "/dummy@0";
		cpufreq_domain2 = "/dummy@0";
		cpu_domain0 = "/dummy@0";
		cpu_domain1 = "/dummy@0";
		cpu_domain2 = "/dummy@0";
		gic = "/dummy@0";
		clock = "/dummy@0";
		mct_map = "/dummy@0";
		pmu_system_controller = "/dummy@0";
		speedy = "/dummy@0";
		speedy1 = "/dummy@0";
		ufs = "/dummy@0";
		ufs_fixed_vcc = "/dummy@0";
		fimg2d = "/dummy@0";
		scaler_0 = "/dummy@0";
		smfc = "/dummy@0";
		jsqz = "/dummy@0";
		dsp = "/dummy@0";
		tsmux = "/dummy@0";
		repeater = "/dummy@0";
		npu = "/dummy@0";
		npuc0 = "/dummy@0";
		npuc1 = "/dummy@0";
		sec_pwm = "/dummy@0";
		exynos_adc = "/dummy@0";
		sysreg_hsi0 = "/dummy@0";
		udc = "/dummy@0";
		usbdrd_dwc3 = "/dummy@0";
		usbdrd_phy0 = "/dummy@0";
		pdma0 = "/dummy@0";
		exynos_dm = "/dummy@0";
		devfreq_0 = "/dummy@0";
		devfreq_1 = "/dummy@0";
		devfreq_2 = "/dummy@0";
		devfreq_3 = "/dummy@0";
		devfreq_4 = "/dummy@0";
		devfreq_5 = "/dummy@0";
		devfreq_6 = "/dummy@0";
		devfreq_7 = "/dummy@0";
		devfreq_8 = "/dummy@0";
		devfreq_9 = "/dummy@0";
		devfreq_10 = "/dummy@0";
		tmuctrl_0 = "/dummy@0";
		tmuctrl_1 = "/dummy@0";
		tmuctrl_2 = "/dummy@0";
		tmuctrl_3 = "/dummy@0";
		tmuctrl_4 = "/dummy@0";
		tmuctrl_5 = "/dummy@0";
		exynos_isp_thermal = "/dummy@0";
		big_thermal = "/dummy@0";
		big_cold = "/dummy@0";
		big_switch_on = "/dummy@0";
		big_control_temp = "/dummy@0";
		big_alert0 = "/dummy@0";
		big_alert1 = "/dummy@0";
		big_alert2 = "/dummy@0";
		big_alert3 = "/dummy@0";
		big_hot = "/dummy@0";
		mid_thermal = "/dummy@0";
		mid_cold = "/dummy@0";
		mid_switch_on = "/dummy@0";
		mid_control_temp = "/dummy@0";
		mid_alert0 = "/dummy@0";
		mid_alert1 = "/dummy@0";
		mid_alert2 = "/dummy@0";
		mid_alert3 = "/dummy@0";
		mid_hot = "/dummy@0";
		little_thermal = "/dummy@0";
		little_alert0 = "/dummy@0";
		little_alert1 = "/dummy@0";
		little_alert2 = "/dummy@0";
		little_alert3 = "/dummy@0";
		little_alert4 = "/dummy@0";
		little_alert5 = "/dummy@0";
		little_alert6 = "/dummy@0";
		little_hot = "/dummy@0";
		gpu_thermal = "/dummy@0";
		gpu_cold = "/dummy@0";
		gpu_switch_on = "/dummy@0";
		gpu_control_temp = "/dummy@0";
		gpu_alert0 = "/dummy@0";
		gpu_alert1 = "/dummy@0";
		gpu_alert2 = "/dummy@0";
		gpu_alert3 = "/dummy@0";
		gpu_hot = "/dummy@0";
		isp_thermal = "/dummy@0";
		isp_alert0 = "/dummy@0";
		isp_alert1 = "/dummy@0";
		isp_alert2 = "/dummy@0";
		isp_alert3 = "/dummy@0";
		isp_alert4 = "/dummy@0";
		isp_alert5 = "/dummy@0";
		isp_alert6 = "/dummy@0";
		isp_hot = "/dummy@0";
		npu_thermal = "/dummy@0";
		npu_alert0 = "/dummy@0";
		npu_alert1 = "/dummy@0";
		npu_alert2 = "/dummy@0";
		npu_alert3 = "/dummy@0";
		npu_alert4 = "/dummy@0";
		npu_alert5 = "/dummy@0";
		npu_alert6 = "/dummy@0";
		npu_hot = "/dummy@0";
		smc_info = "/dummy@0";
		sysreg_hsi1_mmc = "/dummy@0";
		dwmmc_2 = "/dummy@0";
	};
};
